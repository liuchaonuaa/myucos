#include "sys.h"
#include "delay.h"
#include "lcd12864.h"
#include "sst25VF016.h"


u8 cheng[] = {/*--  文字:  成  --*/
	/*--  新宋体12;  此字体下对应的点阵为：宽x高=16x16   --*/
// 	0x00, 0x00, 0xF8, 0x48, 0x48, 0x48, 0xC8, 0x08, 
// 	0xFF, 0x08, 0x09, 0x0A, 0xC8, 0x88, 0x08, 0x00,
// 	0x40, 0x30, 0x0F, 0x00, 0x08, 0x50, 0x4F, 0x20, 
// 	0x10, 0x0B, 0x0C, 0x12, 0x21, 0x40, 0xF0, 0x00

	// 0x23000
	0x00, 0x40, 0x44, 0x54, 0x55, 0x57, 0xd6, 0xfc, 
	0x7c, 0x54, 0x56, 0x57, 0x55, 0x54, 0x44, 0x40,
	0x00, 0x20, 0x30, 0x58, 0x4c, 0x4f, 0x4b, 0x7e, 
	0x7e, 0x4a, 0x4a, 0x7e, 0x7e, 0x40, 0x40, 0x40	
};


// (94*(High8bit-0xa0-1)+(Low8bit-0xa0-1))*32


u8 ji1[] = {/*--  文字:  集  --*/
	/*--  新宋体12;  此字体下对应的点阵为：宽x高=16x16   --*/
	0x00,0x10,0x08,0xFC,0x57,0x54,0x54,0x54,0xFD,0x56,0x54,0x54,0x54,0x00,0x00,0x00,
	0x00,0x44,0x44,0x25,0x25,0x15,0x0D,0xFF,0x05,0x0D,0x15,0x25,0x65,0x25,0x04,0x00
};


#if 0
const unsigned char asc2_1608[95][16] = {	  
    {0x00,0x00,0x00,0x00,0x00,0x00,0x00,0x00,0x00,0x00,0x00,0x00,0x00,0x00,0x00,0x00},// 0
    {0x00,0x00,0x00,0xF8,0x00,0x00,0x00,0x00,0x00,0x00,0x00,0x33,0x30,0x00,0x00,0x00},//!1
    {0x00,0x10,0x0C,0x06,0x10,0x0C,0x06,0x00,0x00,0x00,0x00,0x00,0x00,0x00,0x00,0x00},//"2
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    {0x00,0x06,0x01,0x01,0x02,0x02,0x04,0x04,0x00,0x00,0x00,0x00,0x00,0x00,0x00,0x00},//~94
};
#endif


void delay(vu32 nCount)
{
	nCount *= 5;
	for (; nCount != 0; nCount--);
}


/*
 ******************************
 * 1--CS   <-----> PE14
 * 2--RST  <-----> PE13
 * 3--A0   <-----> PE12
 * 4--SCL  <-----> PD9
 * 5--SDA  <-----> PE11
 * 6--VDD  <-----> 3.3V
 * 7--VSS  <-----> GND
 * 8--VO   <-----> NC
 * 9--XVO  <-----> NC
 * 10--VG  <-----> NC
 ******************************
*/
void LCD_Pin_Init(void)	
{
	GPIO_InitTypeDef GPIO_InitStructure;
 	RCC_APB2PeriphClockCmd(RCC_APB2Periph_GPIOD | RCC_APB2Periph_GPIOE, ENABLE);	//PORTD、PORTE时钟使能 

	GPIO_InitStructure.GPIO_Mode  = GPIO_Mode_Out_PP;
	GPIO_InitStructure.GPIO_Speed = GPIO_Speed_50MHz;
	GPIO_InitStructure.GPIO_Pin   = GPIO_Pin_9;
	GPIO_Init(GPIOD, &GPIO_InitStructure); 

	GPIO_InitStructure.GPIO_Mode  = GPIO_Mode_Out_PP;
	GPIO_InitStructure.GPIO_Speed = GPIO_Speed_50MHz;
	GPIO_InitStructure.GPIO_Pin   = GPIO_Pin_14 | GPIO_Pin_13 | GPIO_Pin_12 | GPIO_Pin_11;		 
	GPIO_Init(GPIOE, &GPIO_InitStructure); 
}


void writecommand(u8 cmd) 
{
	u8 i;
		
	LCD_NSS_0;
	LCD_W_Com;
	
	for (i = 0; i < 8; i++)
	{
		if (cmd & 0x80)
			LCD_MOSI_1;
		else
			LCD_MOSI_0;
		
		LCD_SCK_0;
		LCD_SCK_1;
		
		cmd = cmd << 1;
	}
	
	LCD_NSS_1;
}


void writedata(u8 dat) 
{
	u8 i;
		
	LCD_NSS_0;
	LCD_W_Dat;
	
	for (i = 0; i < 8; i++)
	{
		if (dat & 0x80)
			LCD_MOSI_1;
		else
			LCD_MOSI_0;
		
		LCD_SCK_0;
		LCD_SCK_1;
		
		dat = dat << 1;
	}
	
	LCD_NSS_1;
}


void disp_clear(void)   
{
	u8 i, j;
	
	for (i = 0; i < 8; i++)
	{
		writecommand(0x00);
		writecommand(0xb0 + i);
		writecommand(0x00);
		writecommand(0x10);
		
		for (j = 0; j < 129; j++)
			writedata(0x00);
	}
}


void disp_full(void)
{
	u8 i, j;
	
	for (i = 0; i < 8; i++)
	{
		writecommand(0x00);
		writecommand(0xb0 + i);
		writecommand(0x00);
		writecommand(0x10);
		
		for (j = 0; j < 128; j++)
			writedata(0xf0);
	}
}


void lcd12864_init(void)
{	
	LCD_Pin_Init();
	
	LCD_RST_1;
	delay(30);
	LCD_RST_0;
	delay(30);
	LCD_RST_1;
	delay(100);

	writecommand(0xE2);
	delay(10);
	writecommand(0xA2);	
	writecommand(0xA0);	
	writecommand(0xC8);	
	writecommand(0xF8);
	writecommand(0x00);
	writecommand(0x23);	
	
	// contrast adjust
	writecommand(0x81);	
	writecommand(0x3f);		// change	
	
	writecommand(0x2F);	
	writecommand(0xB0);	
	writecommand(0xAF);	
	writecommand(0xA6);	
	
	disp_clear();
}


void lcd_address(u16 page, u16 column)
{	
	column = column + 1;
	
	if (page < 4)
		writecommand(0xb0 + page + 4);	/*设置页地址*/ //0-7
	else
		writecommand(0xb0 + page - 4);	/*设置页地址*/ //0-7
	
	writecommand(0x10 + ((column>>4) & 0x0f));	/*设置列地址的高4位*///0-128
	writecommand(column & 0x0f);				/*设置列地址的低4位*/	
}


/*显示8x16点阵图像、ASCII, 或8x16点阵的自造字符、其他图标*/
void display_graphic_8x16(u16 page, u8 column, u8 ch)
{
	u8 i, j;
	u8 CharCode[16];
	u8 *dp;
	
	SST25_ReadFlash(CHARADDR+(ch-' ')*16, CharCode, 16);
	dp = CharCode;
		
	for (j = 0; j < 2; j++)
	{
		lcd_address(page+j, column);
		
		for (i = 0; i < 8; i++)
		{	
			writedata(*dp);	 	/*写数据到LCD,每写完一个8位的数据后列地址自动加1*/
			dp++;
		}
	}
}


/*显示16x16点阵图像、汉字、生僻字或16x16点阵的其他图标*/
void display_graphic_16x16(u16 page, u16 column, u8 *code)
{
	u16 i, j;
	u8 HanziCode[32];
	u8 *dp;
	u32 loff;
	
	loff = (94*(code[0]-0xa0-1)+(code[1]-0xa0-1))*32 + ZIKUADDR;
		
	SST25_ReadFlash(loff, HanziCode, 32);
	dp = HanziCode;
	
	for (j = 0; j < 2; j++)
	{
		lcd_address(page+j, column);
		
		for (i = 0; i < 16; i++)
		{	
			writedata(*dp);	 /*写数据到LCD,每写完一个8位的数据后列地址自动加1*/
			dp++;
		}
	}
}


void Show_Str(u8 page, u16 col, u8* str)
{					
	u8 bHz = 0;			// 字符或者中文  	    				    				  	  
	
	while (*str != 0)	// 数据未结束
	{ 
		if (!bHz)
		{
			if (*str > 0x80)	// 中文 
				bHz = 1;
			else	// 字符
			{      				
				display_graphic_8x16(page, col, *str);//有效部分写入 
				str++; 
				col += 8; // 字符,为全字的一半 
			}
		}
		else	// 中文 
		{     
			bHz = 0;	// 有汉字库     						     
			display_graphic_16x16(page, col, str); //显示这个汉字,空心显示 
			str += 2; 
			col += 16;	// 下一个汉字偏移	    
		}						 
	}   
}  			 		


void Show_StrInLine(u8 row, u16 col, u8* str)
{
	if ((row>1) && (row<5) && (col < 120))
		Show_Str((row-1) * 2, col, str);
}



